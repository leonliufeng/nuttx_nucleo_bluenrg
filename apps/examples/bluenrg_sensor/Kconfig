## apps/examples/bluenrg_sensor/Kconfig
```kconfig
#
# For a description of the syntax of this configuration file,
# see the file kconfig-language.txt in the NuttX tools repository.
#

config EXAMPLES_BLUENRG_SENSOR
	bool "\"bluenrg_sensor demo!\" example"
	default n
	---help---
		Enable the \"bluenrg_sensor demo!\" example

if EXAMPLES_BLUENRG_SENSOR

config EXAMPLES_BLUENRG_SENSOR_PROGNAME
	string "Program name"
	default "bluenrg_sensor"
	depends on BUILD_KERNEL
	---help---
		This is the name of the program that will be use when the NSH ELF
		program is installed.

config EXAMPLES_BLUENRG_SENSOR_PRIORITY
	int "bluenrg_sensor task priority"
	default 100

config EXAMPLES_BLUENRG_SENSOR_STACKSIZE
	int "bluenrg_sensor stack size"
	default 2048

endif
```
